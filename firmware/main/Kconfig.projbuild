## firmware/main/Kconfig.projbuild
```kconfig
menu "AI Speaker"

    config APP_DEV_CONSOLE
        bool "Developer console over USB"
        default y
        help
            USB-Serial-JTAG로 명령을 받는 개발용 콘솔 (wifi, key, provision, talk, status 등).
            BLE 프로비저닝(Phase 2)이 생기기 전까지 Phase 1 시험에 쓴다.
            USB로 연결한 사람이 비밀값을 쓸 수 있으므로 배포 빌드에서는 끈다.

    config APP_SPOTIFY
        bool "Spotify voice control (Web API)"
        default n
        help
            Spotify 계정의 다른 기기(휴대폰 등)를 음성으로 제어한다 (Phase 5, 실기기 미검증).
            2026-10-03 사용자 결정으로 끔: 스피커 음질상 음악은 당장 필요 없음.
            끄면 media_spotify가 "연결 안 됨"만 답하는 대체 코드(spotify_off.c)로 빌드된다.
            HTTPS 코드·잠금·초기화가 빠지고, 툴·지시문에도 Spotify가 나오지 않는다.

endmenu
```
